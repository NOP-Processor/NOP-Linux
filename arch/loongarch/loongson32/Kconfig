## arch/loongarch/loongson32/Kconfig
```kconfig
# SPDX-License-Identifier: GPL-2.0
#if MACH_LOONGARCH32

choice
	prompt "Machine Type"

config LOONGSON_MACH3X
	bool "Generic Loongson 3 family machines"
	select ARCH_MIGHT_HAVE_PC_PARPORT
	select ARCH_MIGHT_HAVE_PC_SERIO
	select GENERIC_ISA_DMA_SUPPORT_BROKEN
	select BOOT_ELF32
	select BOARD_SCACHE
	select CPU_HAS_WB
	select HAVE_CLK
	select HW_HAS_PCI
	select ISA
	select HT_PCI
	select IRQ_LOONGISA_CPU
	select NR_CPUS_DEFAULT_4
	select SPARSE_IRQ
	select SYS_HAS_CPU_LOONGSON3
	select SYS_HAS_EARLY_PRINTK
	select SYS_SUPPORTS_64BIT_KERNEL
	select SYS_SUPPORTS_HIGHMEM
	select SYS_SUPPORTS_LITTLE_ENDIAN
	select LOONGSON_MC146818
	select ZONE_DMA32
	select DMA_MAYBE_COHERENT
	select LEFI_FIRMWARE_INTERFACE
	select USE_OF
	select BUILTIN_DTB

	help
		Generic Loongson 3 family machines utilize the 3A/3B revision
		of Loongson processor and LS7A chipset.

config MACH_LOONGSON_32
	bool "Generic Loongson32 machines"
	select BOOT_ELF32
	select CPU_SUPPORTS_CPUFREQ
	select CPU_HAS_WB
	select SYS_HAS_EARLY_PRINTK
#	select SYS_SUPPORTS_HIGHMEM
	select SYS_SUPPORTS_LITTLE_ENDIAN
	select HW_HAS_PCI
	select LEFI_FIRMWARE_INTERFACE
	select IRQ_LOONGISA_CPU
	select OF_FLATTREE
    select ARCH_HAS_SYNC_DMA_FOR_DEVICE
    select DMA_NONCOHERENT
    select ARCH_HAS_SYNC_DMA_FOR_CPU
    select ARCH_HAS_DMA_SET_UNCACHED
#select DMA_MAYBE_COHERENT

endchoice

config LOONGSON_UART_BASE
	bool
	default y
	depends on EARLY_PRINTK || SERIAL_8250

config LOONGSON_MC146818
	bool
	default n

config LEFI_FIRMWARE_INTERFACE
	bool

config DMA_NONCOHERENT
     bool
#endif # MACH_LOONGARCH32
```
